// hal_dryrun.h — HARDWARE_READY 0: no motors, no sensors.
//
// The solver walks the UK 2016 final maze from a table; every "move" is a short
// delay. The on-board button and LED are real when this runs on the DevKitC-1,
// so the contest interface can be tried before a single wire is soldered.

#pragma once
#include "config.h"
#include "solver.h"
#include "hal.h"
#include "board_ui.h"

namespace hal {

// UK 2016 final maze, walls per cell as N=1 E=2 S=4 W=8, index x + 16*y.
// Checked against mazefiles/classic/uk2016f.txt (0 mismatches, 2026-09-23).
static const uint8_t DRY_MAZE[256] PROGMEM = {
0xE,0xC,0x5,0x5,0x4,0x5,0x5,0x5,0x4,0x5,0x5,0x4,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0x5,0x3 };

static const mm::Mouse* dryMouse = nullptr;
static const char* dryError = "no error";

// Move timings in the dry run, so a search run takes a few seconds on the bench.
static const uint32_t DRY_CELL_MS = 30;
static const uint32_t DRY_TURN_MS = 20;
static const uint32_t DRY_TURN_AROUND_MS = 40;

static bool dryWall(uint8_t c, mm::Dir d) { return (pgm_read_byte(&DRY_MAZE[c]) >> d) & 1; }

// Wait in small slices so a button press stops the "wheels" promptly.
static bool dryWait(uint32_t ms) {
  const uint32_t t0 = millis();
  while (millis() - t0 < ms) {
    if (runAbortRequested()) return false;
    delay(5);
  }
  return true;
}

void dryRunAttach(const mm::Mouse* m) { dryMouse = m; }

const char* begin() {
  boardUiBegin();
  led(0, 0, 0);
  return nullptr;
}

const char* lastError() { return dryError; }

const char* runBegin(int) {
  if (!dryMouse) { dryError = "dry run: dryRunAttach() was not called"; return dryError; }
  return nullptr;
}
void runEnd() {}

bool readWalls(bool& left, bool& front, bool& right) {
  if (!dryMouse) return false;
  const uint8_t c = dryMouse->cell;
  const mm::Dir h = dryMouse->heading;
  left  = dryWall(c, mm::leftOf(h));
  front = dryWall(c, h);
  right = dryWall(c, mm::rightOf(h));
  return true;
}

bool forwardOneCell(int) { return dryWait(DRY_CELL_MS); }
bool turnLeft(int)       { return dryWait(DRY_TURN_MS); }
bool turnRight(int)      { return dryWait(DRY_TURN_MS); }
bool turnAround(int)     { return dryWait(DRY_TURN_AROUND_MS); }

void led(uint8_t r, uint8_t g, uint8_t b) { boardLedWrite(r, g, b); }
bool buttonPressed() { return boardButtonPressed(); }

static void notAvailable(const char* what) {
  Serial.print(what);
  Serial.println(": not available in the dry run (HARDWARE_READY is 0)");
}
void benchWalls()    { notAvailable("wall sensors"); }
void benchEncoders() { notAvailable("encoders"); }
void benchImu()      { notAvailable("imu"); }
void benchMotors()   { notAvailable("motor test"); }
void benchBattery()  { notAvailable("battery"); }
void calibrateGyro() { notAvailable("gyro calibration"); }
float batteryVolts() { return 0.0f; }

} // namespace hal
